## conf/bblayers.conf
```bitbake
# LAYER_CONF_VERSION is increased each time build/conf/bblayers.conf
# changes incompatibly
LCONF_VERSION = "6"

BBPATH = "${TOPDIR}"
BBFILES ?= ""

BBLAYERS ?= " \
  /media/e/aria-g25/yocto/poky/meta \
  /media/e/aria-g25/yocto/poky/meta-yocto \
  /media/e/aria-g25/yocto/poky/meta-yocto-bsp \
  /media/e/aria-g25/meta-atmel \
  "
```
